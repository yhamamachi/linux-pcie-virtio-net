// SPDX-License-Identifier: GPL-2.0
/*
 * Device Tree Source for the M3ULCB CCPF SK(ULCB extension) board
 *
 * Copyright (C) 2021 Renesas Electronics Corp.
 */

#include "r8a77960-ulcb.dts"
#include "ulcb-ccpf-sk.dtsi"

/ {
	model = "Renesas M3ULCB CCPF board based on r8a77960";
	compatible = "shimafuji,ccpf-sk", "renesas,m3ulcb",
		     "renesas,r8a7796";
};

